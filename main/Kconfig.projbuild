## main/Kconfig.projbuild
```kconfig
menu "SPIFFS Configuration"

config SPIFFS_BASE_ADDR
    hex "SPIFFS Base address"
    range 0x100000 0x1FFE000
    default 0x180000
    help
	Starting address of the SPIFFS area in ESP32 Flash
	Write the address in hex format, 0x180000

config SPIFFS_SIZE
    int "SPIFFS Size in bytes"
    range 65536 262144
    default 65536

config SPIFFS_LOG_BLOCK_SIZE
    int "SPIFFS Logical block size"
    range 4096 65536
    default 4096

config SPIFFS_LOG_PAGE_SIZE
    int "SPIFFS Logical page size"
    range 256 2048
    default 256
    help
	Set it to the physical page size of the SPI Flash chip.

endmenu
```
